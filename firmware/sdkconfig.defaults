## firmware/sdkconfig.defaults
```kconfig
# ---- Target / flash ----
CONFIG_IDF_TARGET="esp32p4"
CONFIG_ESPTOOLPY_FLASHMODE_DIO=y
CONFIG_ESPTOOLPY_FLASHFREQ_80M=y
CONFIG_ESPTOOLPY_FLASHSIZE_16MB=y
CONFIG_PARTITION_TABLE_CUSTOM=y
CONFIG_PARTITION_TABLE_CUSTOM_FILENAME="partitions.csv"
CONFIG_PARTITION_TABLE_OFFSET=0x8000
CONFIG_BOOTLOADER_OFFSET_IN_FLASH=0x2000
CONFIG_ESP_DEFAULT_CPU_FREQ_MHZ_360=y
CONFIG_ESP32P4_SELECTS_REV_LESS_V3=y
CONFIG_ESP_CONSOLE_USB_SERIAL_JTAG=y
CONFIG_ESP_MAIN_TASK_STACK_SIZE=16384
CONFIG_ESP_SYSTEM_EVENT_TASK_STACK_SIZE=4096
CONFIG_FREERTOS_HZ=1000
CONFIG_COMPILER_OPTIMIZATION_PERF=y
CONFIG_ESP_TASK_WDT_TIMEOUT_S=15
CONFIG_ESP_TASK_WDT_CHECK_IDLE_TASK_CPU0=n
CONFIG_ESP_TASK_WDT_CHECK_IDLE_TASK_CPU1=n

# ---- PSRAM / cache ----
CONFIG_IDF_EXPERIMENTAL_FEATURES=y
CONFIG_SPIRAM=y
CONFIG_SPIRAM_MODE_HEX=y
CONFIG_SPIRAM_SPEED_200M=y
CONFIG_SPIRAM_XIP_FROM_PSRAM=y
CONFIG_SPIRAM_USE_MALLOC=y
# Full 32 MB validation costs roughly 350 ms on every production boot. PSRAM
# initialization and timing calibration still run with this disabled.
# CONFIG_SPIRAM_MEMTEST is not set
CONFIG_SPIRAM_MALLOC_ALWAYSINTERNAL=512
CONFIG_SPIRAM_MALLOC_RESERVE_INTERNAL=65536
CONFIG_SPIRAM_TRY_ALLOCATE_WIFI_LWIP=y
CONFIG_CACHE_L2_CACHE_256KB=y
CONFIG_CACHE_L2_CACHE_LINE_128B=y

# ---- WiFi over ESP32-C6 (esp_hosted SDIO, Tab5 wiring) ----
CONFIG_ESP_WIFI_REMOTE_ENABLED=y
CONFIG_ESP_WIFI_REMOTE_LIBRARY_HOSTED=y
CONFIG_SLAVE_IDF_TARGET_ESP32C6=y
CONFIG_ESP_HOSTED_ENABLED=y
CONFIG_ESP_HOSTED_HOST_TRANSPORT_BUS_SDIO=y
CONFIG_ESP_HOSTED_IDF_SLAVE_TARGET="esp32c6"
CONFIG_ESP_HOSTED_HOST_SDIO_BUS_WIDTH_4=y
CONFIG_ESP_HOSTED_HOST_SDIO_PIN_CMD=13
CONFIG_ESP_HOSTED_HOST_SDIO_PIN_CLK=12
CONFIG_ESP_HOSTED_HOST_SDIO_PIN_D0=11
CONFIG_ESP_HOSTED_HOST_SDIO_PIN_D1=10
CONFIG_ESP_HOSTED_HOST_SDIO_PIN_D2=9
CONFIG_ESP_HOSTED_HOST_SDIO_PIN_D3=8
CONFIG_ESP_HOSTED_HOST_RESET_GPIO=15
CONFIG_ESP_HOSTED_HOST_SDIO_SLOT=1
CONFIG_ESP_HOSTED_HOST_SDIO_CLK_KHZ=40000
CONFIG_ESP_HOSTED_HOST_RESET_ACTIVE_LOW=y
CONFIG_ESP_HOSTED_RESET_GPIO_ACTIVE_LOW=y
CONFIG_ESP_HOSTED_HOST_SDIO_RX_STREAMING_MODE=y
CONFIG_ESP_HOSTED_USE_MEMPOOL=y
CONFIG_WIFI_RMT_ENABLE_WPA3_SAE=y
CONFIG_LWIP_IPV6=y
CONFIG_LWIP_IPV6_AUTOCONFIG=y
CONFIG_LWIP_SO_RCVBUF=y
CONFIG_LWIP_MAX_SOCKETS=16
CONFIG_LWIP_TCP_WND_DEFAULT=32768
CONFIG_LWIP_TCP_SND_BUF_DEFAULT=32768
CONFIG_LWIP_TCP_RECVMBOX_SIZE=32

# ---- HTTP server (web file manager) ----
CONFIG_HTTPD_MAX_REQ_HDR_LEN=2048
CONFIG_HTTPD_MAX_URI_LEN=1024
CONFIG_HTTPD_PURGE_BUF_LEN=64

# ---- mbedTLS ----
CONFIG_MBEDTLS_EXTERNAL_MEM_ALLOC=y
CONFIG_MBEDTLS_CERTIFICATE_BUNDLE=y
CONFIG_MBEDTLS_HARDWARE_AES=y
CONFIG_MBEDTLS_HARDWARE_SHA=y
CONFIG_MBEDTLS_CMAC_C=y
CONFIG_MBEDTLS_CHACHA20_C=y
CONFIG_MBEDTLS_POLY1305_C=y
CONFIG_MBEDTLS_CHACHAPOLY_C=y
CONFIG_MBEDTLS_ECP_DP_CURVE25519_ENABLED=y

# ---- FATFS (TF card, CJK long file names) ----
CONFIG_FATFS_LFN_HEAP=y
CONFIG_FATFS_MAX_LFN=255
CONFIG_FATFS_API_ENCODING_UTF_8=y
CONFIG_FATFS_CODEPAGE_DYNAMIC=y
CONFIG_FATFS_USE_FASTSEEK=y
CONFIG_FATFS_VFS_FSTAT_BLKSIZE=4096
CONFIG_FATFS_VOLUME_COUNT=4
CONFIG_FATFS_IMMEDIATE_FSYNC=n

# ---- BSP ----
CONFIG_BSP_I2C_NUM=1
CONFIG_BSP_SD_MOUNT_POINT="/sdcard"
CONFIG_BSP_LCD_DRAW_BUF_HEIGHT=50
CONFIG_BSP_LCD_DRAW_BUF_DOUBLE=y
CONFIG_BSP_LCD_USE_DMA2D=y
CONFIG_BSP_LCD_DPI_BUFFER_NUMS=1
CONFIG_LVGL_PORT_ENABLE_PPA=y

# ---- Tab5 MIPI-CSI camera (SC202CS) ----
CONFIG_CAMERA_SC202CS=y
CONFIG_CAMERA_SC202CS_AUTO_DETECT_MIPI_INTERFACE_SENSOR=y
CONFIG_CAMERA_SC202CS_MIPI_RAW8_1280X720_30FPS=y
CONFIG_CAMERA_SC202CS_MIPI_DEFAULT_FMT_RAW8_1280X720_30FPS=y

# ---- LVGL 9 ----
CONFIG_LV_COLOR_DEPTH_16=y
CONFIG_LV_USE_CLIB_MALLOC=y
CONFIG_LV_USE_CLIB_STRING=y
CONFIG_LV_USE_CLIB_SPRINTF=y
CONFIG_LV_DEF_REFR_PERIOD=16
CONFIG_LV_DRAW_BUF_ALIGN=64
CONFIG_LV_USE_DRAW_SW_ASM_NONE=y
CONFIG_LV_FONT_FMT_TXT_LARGE=y
CONFIG_LV_USE_FONT_COMPRESSED=y
CONFIG_LV_USE_FONT_PLACEHOLDER=y
CONFIG_LV_FONT_MONTSERRAT_14=y
CONFIG_LV_FONT_MONTSERRAT_16=y
CONFIG_LV_FONT_MONTSERRAT_22=y
CONFIG_LV_FONT_MONTSERRAT_30=y
CONFIG_LV_FONT_DEFAULT_MONTSERRAT_22=y
CONFIG_LV_TXT_ENC_UTF8=y
CONFIG_LV_USE_LODEPNG=y
CONFIG_LV_USE_BMP=y
CONFIG_LV_USE_TJPGD=y
CONFIG_LV_USE_GIF=y
CONFIG_LV_USE_SNAPSHOT=y
CONFIG_LV_USE_QRCODE=y
CONFIG_LV_USE_FS_STDIO=y
CONFIG_LV_FS_STDIO_LETTER=83
CONFIG_LV_FS_STDIO_PATH=""
CONFIG_LV_FS_STDIO_CACHE_SIZE=4096
CONFIG_LV_CACHE_DEF_SIZE=4194304
CONFIG_LV_IMAGE_HEADER_CACHE_DEF_CNT=16
CONFIG_LV_USE_OBSERVER=y
CONFIG_LV_USE_TEXTAREA=y
CONFIG_LV_USE_KEYBOARD=y
CONFIG_LV_USE_MSGBOX=y
CONFIG_LV_USE_LIST=y
CONFIG_LV_USE_SPAN=y
CONFIG_LV_USE_SPINNER=y
CONFIG_LV_USE_CANVAS=y
CONFIG_LV_USE_DROPDOWN=y
CONFIG_LV_USE_ROLLER=y
CONFIG_LV_USE_SLIDER=y
CONFIG_LV_USE_SWITCH=y
CONFIG_LV_USE_TABVIEW=y
CONFIG_LV_USE_TILEVIEW=y
CONFIG_LV_USE_BAR=y
CONFIG_LV_USE_ARC=y
CONFIG_LV_USE_LOG=n
CONFIG_LV_USE_IME_PINYIN=n
CONFIG_LV_USE_TINY_TTF=n
CONFIG_LV_USE_THEME_DEFAULT=y
CONFIG_LV_USE_FLEX=y
CONFIG_LV_USE_GRID=y
CONFIG_LV_USE_PPA=n

# ---- TinyUSB (USB disk mode) ----
CONFIG_TINYUSB_MSC_ENABLED=y
CONFIG_TINYUSB_DESC_MANUFACTURER_STRING="M5Stack"
CONFIG_TINYUSB_DESC_PRODUCT_STRING="Clientre 5"
CONFIG_TINYUSB_MSC_BUFSIZE=4096

# ---- App ----
CONFIG_APP_COMPILE_TIME_DATE=y
CONFIG_ESP_HTTP_CLIENT_ENABLE_HTTPS=y
CONFIG_ESP_HTTPS_OTA_ALLOW_HTTP=y
CONFIG_NVS_ENCRYPTION=n
CONFIG_PTHREAD_TASK_STACK_SIZE_DEFAULT=8192
CONFIG_LIBC_OPTIMIZED_MISALIGNED_ACCESS=n

# ---- Tailscale (MicroLink) ----
CONFIG_MBEDTLS_HKDF_C=y
CONFIG_LWIP_TCPIP_RECVMBOX_SIZE=64
CONFIG_ML_MAX_PEERS=16
CONFIG_ML_H2_BUFFER_SIZE_KB=256
CONFIG_ML_JSON_BUFFER_SIZE_KB=256
```

## firmware/updater/sdkconfig.defaults
```kconfig
CONFIG_IDF_TARGET="esp32p4"
CONFIG_ESPTOOLPY_FLASHMODE_DIO=y
CONFIG_ESPTOOLPY_FLASHFREQ_80M=y
CONFIG_ESPTOOLPY_FLASHSIZE_16MB=y
CONFIG_PARTITION_TABLE_CUSTOM=y
CONFIG_PARTITION_TABLE_CUSTOM_FILENAME="partitions.csv"
CONFIG_PARTITION_TABLE_OFFSET=0x8000
CONFIG_BOOTLOADER_OFFSET_IN_FLASH=0x2000
CONFIG_ESP_CONSOLE_USB_SERIAL_JTAG=y
CONFIG_COMPILER_OPTIMIZATION_SIZE=y
CONFIG_ESP_MAIN_TASK_STACK_SIZE=8192
CONFIG_SPIRAM=n
CONFIG_FATFS_LFN_HEAP=y
CONFIG_FATFS_MAX_LFN=255
CONFIG_ESP_ERR_TO_NAME_LOOKUP=n
CONFIG_LOG_DEFAULT_LEVEL_INFO=y
CONFIG_ESP_WIFI_ENABLED=n
CONFIG_BT_ENABLED=n
CONFIG_ESP_TASK_WDT_INIT=n
CONFIG_ESP_INT_WDT=n
CONFIG_MBEDTLS_CERTIFICATE_BUNDLE=n
```
